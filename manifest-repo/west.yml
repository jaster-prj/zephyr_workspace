## manifest-repo/west.yml
```yaml
manifest:
  remotes:
    - name: zephyrproject-rtos
      url-base: https://github.com/zephyrproject-rtos
    - name: jaster-prj
      url-base: https://github.com/jaster-prj
  projects:
    - name: zephyr
      remote: zephyrproject-rtos
      revision: v4.4.2
      import: true
    - name: canopennodezephyr
      url: https://github.com/zephyrproject-rtos/CANopenNodeZephyr.git
      revision: main
      submodules:
        - path: CANopenNode
    - name: zephyr_boards
      remote: jaster-prj
      revision: main
      path: modules/jaster_prj_boards
    - name: zephyr-native-linux-udp-can
      remote: jaster-prj
      revision: main
  self:
    path: manifest-repo
```
